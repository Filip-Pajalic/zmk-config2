/*
 * Copyright (c) 2020 The ZMK Contributors
 *
 * SPDX-License-Identifier: MIT
 */

#include "../knucklehead/base.dtsi"

// Alpha layer: uncomment desired, comment the others
#include "../knucklehead/L1_colemak-dh.dtsi"
// #include "../knucklehead/L1_colemak.dtsi"
// #include "../knucklehead/L1_qwerty.dtsi"

// Other layers
#include "../knucklehead/L2.dtsi"
#include "../knucklehead/L3.dtsi"

&nice_view_spi {
    cs-gpios = <&gpio0 8 GPIO_ACTIVE_HIGH>;
};
